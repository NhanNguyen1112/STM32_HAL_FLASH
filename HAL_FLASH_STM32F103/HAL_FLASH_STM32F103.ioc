# file: HAL_FLASH_STM32F103.ioc
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Mcu.Family=STM32F1
Mcu.Name=STM32F103C(8-B)Tx
Mcu.Package=LQFP48
NVIC.PriorityGroup=NVIC_PRIORITYGROUP_4
PA13.Mode=Serial_Wire
PA13.Signal=SYS_JTMS-SWDIO
PA14.Mode=Serial_Wire
PA14.Signal=SYS_JTCK-SWCLK
PD0-OSC_IN.Mode=HSE-External-Oscillator
PD0-OSC_IN.Signal=RCC_OSC_IN
PD1-OSC_OUT.Mode=HSE-External-Oscillator
PD1-OSC_OUT.Signal=RCC_OSC_OUT
ProjectManager.HeapSize=0x200
ProjectManager.StackSize=0x400
ProjectManager.TargetToolchain=STM32CubeIDE
RCC.AHBFreq_Value=72000000
RCC.APB1CLKDivider=RCC_HCLK_DIV2
RCC.APB1Freq_Value=36000000
RCC.APB1TimFreq_Value=72000000
RCC.APB2Freq_Value=72000000
RCC.APB2TimFreq_Value=72000000
RCC.HCLKFreq_Value=72000000
RCC.PLLMUL=RCC_PLL_MUL9
RCC.PLLSourceVirtual=RCC_PLLSOURCE_HSE
RCC.SYSCLKFreq_VALUE=72000000
RCC.SYSCLKSource=RCC_SYSCLKSOURCE_PLLCLK
RCC.USBFreq_Value=72000000
board=custom

// file: Core/Src/main.c
/* USER CODE BEGIN Header */
/**
  ******************************************************************************
  * @file           : main.c
  * @brief          : Main program body
  ******************************************************************************
  * @attention
  *
  * Copyright (c) 2023 STMicroelectronics.
  * All rights reserved.
  *
  * This software is licensed under terms that can be found in the LICENSE file
  * in the root directory of this software component.
  * If no LICENSE file comes with this software, it is provided AS-IS.
  *
  ******************************************************************************
  */
/* USER CODE END Header */
#include "main.h"
#include "gpio.h"

void SystemClock_Config(void);

/* USER CODE BEGIN 0 */

HAL_StatusTypeDef FLASH_ClearPage(uint32_t PageAddress)
{
	HAL_StatusTypeDef StatusReturn=HAL_OK;
	uint32_t PageError;
	HAL_FLASH_Unlock();
	FLASH_EraseInitTypeDef EraseInitStruct;
	EraseInitStruct.TypeErase = FLASH_TYPEERASE_PAGES;
	EraseInitStruct.PageAddress = PageAddress;
	EraseInitStruct.NbPages = 1;
	if (HAL_FLASHEx_Erase(&EraseInitStruct, &PageError) != HAL_OK) StatusReturn=HAL_ERROR;
	HAL_Delay(10);
	HAL_FLASH_Lock();

	return StatusReturn;
}

HAL_StatusTypeDef FLASH_Write(uint32_t Address,uint32_t *Data)
{
	HAL_StatusTypeDef StatusReturn=HAL_OK;

    HAL_FLASH_Unlock();
	StatusReturn=HAL_FLASH_Program(FLASH_TYPEPROGRAM_WORD,Address,(uint64_t)*Data);
	HAL_Delay(5);
	HAL_FLASH_Lock();

	return StatusReturn;
}

HAL_StatusTypeDef FLASH_WriteBuffer(uint32_t Address, uint32_t *Buffer, uint32_t Lenghth)
{
	HAL_StatusTypeDef StatusReturn=HAL_OK;

	for(uint32_t Count=0; Count<Lenghth; Count++)
	{
		StatusReturn=FLASH_Write(Address, Buffer);
		if(StatusReturn!=HAL_OK) break;
		Address+=4;
		Buffer+=1;
	}

	return StatusReturn;
}

uint32_t FLASH_Read(uint32_t Address)
{
	__IO uint32_t Read_Data = *(__IO uint32_t *)Address;
	return (uint32_t)Read_Data;
}

void FLASH_ReadBuffer(uint32_t Address, uint32_t *BufferRead, uint32_t Length)
{
	for(uint32_t Count=0; Count<Length; Count++)
	{
		*BufferRead=FLASH_Read(Address);

		Address+=4;
		BufferRead+=1;
	}
}

/* USER CODE END 0 */

int main(void)
{

  /* MCU Configuration--------------------------------------------------------*/

  /* Reset of all peripherals, Initializes the Flash interface and the Systick. */
  HAL_Init();

  /* Configure the system clock */
  SystemClock_Config();

  /* Initialize all configured peripherals */
  MX_GPIO_Init();
  /* USER CODE BEGIN 2 */
  uint32_t DATA_write = 0x12345678;
  uint32_t DATA_write2 = 0x99887766;
  uint32_t BUFFER_write[3]={0x12345678,0x88776655,0x00001122};
  uint32_t BUFFER_read[3];
  uint32_t ReadTEST;

  FLASH_ClearPage(0x0801FC00);

  FLASH_WriteBuffer(0x0801FC00, BUFFER_write, 3);

  FLASH_ReadBuffer(0x0801FC00, BUFFER_read, 3);

//  FLASH_Write(0x0801FC00, &DATA_write);
//  FLASH_Write(0x0801FC04, &DATA_write2);

  ReadTEST = FLASH_Read(0x0801FC00);

  FLASH_ClearPage(0x0801FC00);

  /* USER CODE END 2 */

  /* Infinite loop */
  while (1)
  {

  }
}

void SystemClock_Config(void)
{
  RCC_OscInitTypeDef RCC_OscInitStruct = {0};
  RCC_ClkInitTypeDef RCC_ClkInitStruct = {0};

  /** Initializes the RCC Oscillators according to the specified parameters
  * in the RCC_OscInitTypeDef structure.
  */
  RCC_OscInitStruct.OscillatorType = RCC_OSCILLATORTYPE_HSE;
  RCC_OscInitStruct.HSEState = RCC_HSE_ON;
  RCC_OscInitStruct.HSEPredivValue = RCC_HSE_PREDIV_DIV1;
  RCC_OscInitStruct.HSIState = RCC_HSI_ON;
  RCC_OscInitStruct.PLL.PLLState = RCC_PLL_ON;
  RCC_OscInitStruct.PLL.PLLSource = RCC_PLLSOURCE_HSE;
  RCC_OscInitStruct.PLL.PLLMUL = RCC_PLL_MUL9;
  if (HAL_RCC_OscConfig(&RCC_OscInitStruct) != HAL_OK)
  {
    Error_Handler();
  }

  /** Initializes the CPU, AHB and APB buses clocks
  */
  RCC_ClkInitStruct.ClockType = RCC_CLOCKTYPE_HCLK|RCC_CLOCKTYPE_SYSCLK
                              |RCC_CLOCKTYPE_PCLK1|RCC_CLOCKTYPE_PCLK2;
  RCC_ClkInitStruct.SYSCLKSource = RCC_SYSCLKSOURCE_PLLCLK;
  RCC_ClkInitStruct.AHBCLKDivider = RCC_SYSCLK_DIV1;
  RCC_ClkInitStruct.APB1CLKDivider = RCC_HCLK_DIV2;
  RCC_ClkInitStruct.APB2CLKDivider = RCC_HCLK_DIV1;

  if (HAL_RCC_ClockConfig(&RCC_ClkInitStruct, FLASH_LATENCY_2) != HAL_OK)
  {
    Error_Handler();
  }
}

void Error_Handler(void)
{
  __disable_irq();
  while (1)
  {
  }
}
